## base_external/package/aesd-assignments/Config.in
```kconfig
config BR2_PACKAGE_AESD_ASSIGNMENTS
	bool "aesd-assignments"
	help
          Includes the aesdsocket executable, aesdsocket-start-stop.sh init script in the kernel image
	  Used to understand buildroot external trees and package builds.
```

## base_external/package/ldd/Config.in
```kconfig
config BR2_PACKAGE_LDD
	bool "ldd"
	help
          Building and installing misc-modules and scull components
	  Used to understand buildroot building kernel resources. 
```
